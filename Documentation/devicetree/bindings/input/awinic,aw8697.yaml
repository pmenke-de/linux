## Documentation/devicetree/bindings/input/awinic,aw8697.yaml
```yaml
# SPDX-License-Identifier: (GPL-2.0-only OR BSD-2-Clause)
%YAML 1.2
---
$id: http://devicetree.org/schemas/input/awinic,aw8697.yaml#
$schema: http://devicetree.org/meta-schemas/core.yaml#

title: Awinic AW8697 LRA Haptic IC

maintainers:
  - Philipp Menke <pmenke@pmenke.de>

properties:
  compatible:
    const: awinic,aw8697

  reg:
    maxItems: 1

  reset-gpios:
    maxItems: 1

  interrupts:
    maxItems: 1

required:
  - compatible
  - reg
  - reset-gpios
  - interrupts

additionalProperties: false

examples:
  - |
    #include <dt-bindings/gpio/gpio.h>
    #include <dt-bindings/interrupt-controller/irq.h>

    i2c {
        #address-cells = <1>;
        #size-cells = <0>;

        vibrator@5a {
            compatible = "awinic,aw8697";
            reg = <0x5a>;
            interrupts-extended = <&tlmm 129 IRQ_TYPE_EDGE_FALLING>;
            reset-gpios = <&tlmm 130 GPIO_ACTIVE_LOW>;
        };
    };
```

## drivers/bus/mhi/host/Kconfig
```kconfig
# SPDX-License-Identifier: GPL-2.0
#
# MHI bus
#
# Copyright (c) 2018-2020, The Linux Foundation. All rights reserved.
#

config MHI_BUS
	tristate "Modem Host Interface (MHI) bus"
	help
	  Bus driver for MHI protocol. Modem Host Interface (MHI) is a
	  communication protocol used by the host processors to control
	  and communicate with modem devices over a high speed peripheral
	  bus or shared memory.

config MHI_BUS_DEBUG
	bool "Debugfs support for the MHI bus"
	depends on MHI_BUS && DEBUG_FS
	help
	  Enable debugfs support for use with the MHI transport. Allows
	  reading and/or modifying some values within the MHI controller
	  for debug and test purposes.

config MHI_BUS_PCI_GENERIC
	tristate "MHI PCI controller driver"
	depends on MHI_BUS
	depends on PCI
	help
	  This driver provides MHI PCI controller driver for devices such as
	  Qualcomm SDX55 based PCIe modems.

config MHI_BUS_SAHARA_MODEM
	tristate "MHI Sahara modem firmware loader"
	depends on MHI_BUS
	help
	  Driver that implements the Sahara v2 firmware transfer protocol
	  over MHI channels 2/3.  Required for Qualcomm Fusion modems
	  (e.g. SDX55 on Xiaomi Mi 10T / Apollo) that have no onboard
	  flash and load AMSS via Sahara after SBL EE.

config MHI_BUS_BL_LOGGER
	tristate "MHI boot logger client"
	depends on MHI_BUS
	default y if MHI_BUS_PCI_GENERIC
	help
	  Driver that drains the SBL boot-logger channel exposed by some
	  Qualcomm PCIe modems. This is used by vendor SDX55 fusion setups
	  alongside SAHARA during early boot.

config MHI_BUS_SATELLITE
	tristate "MHI satellite (share channels with a remote subsystem)"
	depends on MHI_BUS && RPMSG
	help
	  Let a remote subsystem drive some of the MHI channels itself. The
	  remote supplies its own channel and event ring contexts over a
	  glink/rpmsg link and rings the doorbells directly; this driver only
	  proxies the operations it cannot perform, such as IOMMU mapping and
	  channel start/stop.

	  Needed for call audio on boards where the modem is on PCIe and the
	  audio DSP has to talk to it without the CPU in the data path.

config MHI_BUS_CHAN_KEEPALIVE
	tristate "MHI control-channel keep-alive (SDX55 Fusion)"
	depends on MHI_BUS
	default y if MHI_BUS_PCI_GENERIC
	help
	  Open and keep alive the EFS/QMI1/IP_CTRL MHI channels exposed by
	  the SDX55 Fusion AMSS execution environment.  Vendor kernels open
	  these via DT-defined client mappings; mainline declares them in
	  the controller config but no in-tree client binds, so the channels
	  are never STARTed.  Used as a hypothesis test for whether channel
	  completeness affects post-MISSION modem stability on Apollo.
```

## drivers/input/touchscreen/nt36523/Kconfig
```kconfig
#
# Novatek NT36523 / NT36675 touchscreen driver configuration
#
config TOUCHSCREEN_NT36523_SPI
	tristate "Novatek NT36523/NT36675 no flash SPI driver"
	default n
	help
	  Say Y here if you have a Novatek NT36523 or NT36675 no-flash
	  touchscreen connected to your system by SPI bus.

	  This driver also supports the NT36675 found on the Xiaomi Apollo,
	  including the vendor-derived MP (multipoint) self-test feature and
	  ESD display recovery via the FFM-to-CPU bridge.

	  If unsure, say N.
```
